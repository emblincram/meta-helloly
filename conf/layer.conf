## conf/layer.conf
```bitbake
# We have a conf and classes directory, add to BBPATH
BBPATH .= ":${LAYERDIR}"

# We have recipes-* directories, add to BBFILES
BBFILES += "${LAYERDIR}/recipes-*/*/*.bb \
            ${LAYERDIR}/recipes-*/*/*.bbappend"

BBFILE_COLLECTIONS += "meta-helloly"
BBFILE_PATTERN_meta-helloly = "^${LAYERDIR}/"
BBFILE_PRIORITY_meta-helloly = "6"

# bitbake -e | grep "^DISTRO_CODENAME="
LAYERDEPENDS_meta-helloly = "core"
LAYERSERIES_COMPAT_meta-helloly = "kirkstone"
```
